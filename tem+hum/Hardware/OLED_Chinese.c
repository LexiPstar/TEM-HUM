#include "OLED_Chinese.h"
#include "OLED.h"
#include <string.h>

// ------------------ 字模区 ------------------
// “你”
const uint8_t Font_Ni[32] = {
    0x00,0x20,0x10,0x20,0x10,0x40,0x13,0xFE,
    0xFD,0x00,0x11,0x10,0x11,0x10,0x15,0x10,
    0x19,0x10,0x51,0x10,0x91,0x10,0x11,0x28,
    0x11,0x44,0x12,0x82,0x14,0x00,0x08,0x00
};

// “好”
const uint8_t Font_Hao[32] = {
    0x08,0x40,0x08,0x40,0x08,0x40,0x7F,0xFE,
    0x08,0x40,0x08,0x40,0x1F,0xF0,0x10,0x10,
    0x10,0x10,0x1F,0xF0,0x10,0x10,0x10,0x10,
    0x1F,0xF0,0x10,0x10,0x00,0x10,0x00,0x10
};

// “世”
const uint8_t Font_Shi[32] = {
    0x00,0x80,0x3F,0xFC,0x02,0x00,0x04,0x00,
    0x0F,0xE0,0x10,0x20,0x3F,0xFC,0x10,0x20,
    0x0F,0xE0,0x04,0x00,0x04,0x00,0xFF,0xFE,
    0x04,0x00,0x04,0x00,0x04,0x00,0x04,0x00
};

// “界”
const uint8_t Font_Jie[32] = {
    0x01,0x00,0x11,0x10,0x11,0x10,0x11,0x10,
    0x11,0x10,0x1F,0xF0,0x10,0x10,0x10,0x10,
    0x10,0x10,0x1F,0xF0,0x10,0x10,0x10,0x10,
    0x10,0x10,0xFF,0xFE,0x00,0x00,0x00,0x00
};

// ------------------ 显示函数 ------------------

void OLED_ShowChinese(uint8_t x, uint8_t y, const uint8_t *font)
{
    OLED_SetCursor(x, y);
    for (uint8_t i = 0; i < 16; i++)
        OLED_WriteData(font[i]);

    OLED_SetCursor(x, y + 1);
    for (uint8_t i = 16; i < 32; i++)
        OLED_WriteData(font[i]);
}

// 字符与点阵映射表
typedef struct {
    char* word;
    const uint8_t* font;
} FontMap;

const FontMap font_map[] = {
    {"你", Font_Ni},
    {"好", Font_Hao},
    {"世", Font_Shi},
    {"界", Font_Jie},
};

void OLED_ShowChineseString(uint8_t x, uint8_t y, const char *text)
{
    uint8_t i = 0, font_count = sizeof(font_map)/sizeof(font_map[0]);
    
    while (*text && *(text + 1))  // 汉字是两个字节（UTF8 简单处理）
    {
        for (uint8_t j = 0; j < font_count; j++)
        {
            if (strncmp(text, font_map[j].word, strlen(font_map[j].word)) == 0)
            {
                OLED_ShowChinese(x + i * 16, y, font_map[j].font);
                i++;
                break;
            }
        }
        text += 3;  // UTF-8 中文占 3 字节
    }
}
